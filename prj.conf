## CMakeLists.txt
```
# SPDX-License-Identifier: Apache-2.0
cmake_minimum_required(VERSION 3.13.1)
set(BOARD nucleo_l432kc)

find_package(Zephyr REQUIRED HINTS $ENV{ZEPHYR_BASE})
project(stm32_pm_blinky)


# SPI

# target_sources(app PRIVATE src/spi/transceive_master_double.cpp)
target_sources(app PRIVATE src/spi/transceive_slave_double.cpp)

# UART

# target_sources(app PRIVATE src/uart/uart_send.cpp)

target_include_directories(app PUBLIC external/PX4-Matrix)
```

## prj.conf
```kconfig
CONFIG_GPIO=y

CONFIG_SPI=y
CONFIG_PM=y
CONFIG_PM_DEVICE=y
CONFIG_PM_DEVICE_RUNTIME=y

CONFIG_NEWLIB_LIBC=y
CONFIG_CPLUSPLUS=y
CONFIG_LIB_CPLUSPLUS=y
CONFIG_STD_CPP17=y

CONFIG_NEWLIB_LIBC_FLOAT_PRINTF=y

CONFIG_UART_INTERRUPT_DRIVEN=y
```

## src/main.cpp
```c
#include <device.h>
#include <drivers/spi.h>

int spi_slave_read(const struct device *spi, struct spi_config *spi_cfg, uint16_t *data)
{
	struct spi_buf bufs = { .buf = data, .len = 2 };
	struct spi_buf_set rx = { .buffers = &bufs };

	rx.count = 1;

	return spi_read(spi, spi_cfg, &rx);
}

int spi_slave_write(const struct device *spi, struct spi_config *spi_cfg, uint16_t *data)
{
	struct spi_buf bufs = { .buf = data, .len = 2 };
	struct spi_buf_set tx = { .buffers = &bufs };

	tx.count = 1;

	return spi_write(spi, spi_cfg, &tx);
}

void main()
{
	// Data to be exchanged
	uint16_t tx_data = 200;
	uint16_t rx_data = 8;

	// Initialize SPI bus number 3
	const struct device *spi = device_get_binding("SPI_1");

	// Chip select pin
	const spi_cs_control cs_ctrl = {
		.gpio_dev = device_get_binding("GPIOB"),
		.delay = 0,
		.gpio_pin = 6,
		.gpio_dt_flags = GPIO_ACTIVE_LOW,
	};

	// SPI COnfiguration
	struct spi_config spi_cfg {
		.frequency = 3600000U,
		.operation = SPI_WORD_SET(8) | SPI_TRANSFER_MSB | SPI_OP_MODE_MASTER, .cs = &cs_ctrl
	};

	while (1) {
		spi_slave_read(spi, &spi_cfg, &rx_data);

		if (rx_data == 10) {
			spi_slave_write(spi, &spi_cfg, &tx_data);
		} else {
			spi_slave_write(spi, &spi_cfg, &tx_data);
		}
		printk("Received: 0x%04X -- %s\n", rx_data, (rx_data == 0x1234) ? "ok" : "wrong");
	}
}
```

## src/main_math.cpp
```c
#include <zephyr.h>
#include <sys/printk.h>
#include <math.h>
#include <stdio.h>
#include <matrix/math.hpp>

// #include <iostream>

using namespace matrix;

int main()
{
	float roll = 0.1f;
	float pitch = 0.2f;
	float yaw = 0.3f;
	Eulerf euler(roll, pitch, yaw);

	// convert to quaternion from euler
	Quatf q_nb(euler);

	// convert to DCM from quaternion
	Dcmf dcm(q_nb);

	// you can assign a rotation instance that already exist to another rotation instance, e.g.
	dcm = euler;

	// you can also directly create a DCM instance from euler angles like this
	dcm = Eulerf(roll, pitch, yaw);

	// do some kalman filtering
	const size_t n_x = 5;
	const size_t n_y = 3;

	// define matrix sizes
	SquareMatrix<float, n_x> P;
	Vector<float, n_x> x;
	Vector<float, n_y> y;
	Matrix<float, n_y, n_x> C;
	SquareMatrix<float, n_y> R;
	SquareMatrix<float, n_y> S;
	Matrix<float, n_x, n_y> K;

	x.setZero();

	return 0;
}
```

## src/main_slave.cpp
```c
#include <device.h>
#include <drivers/spi.h>

int spi_slave_read(const struct device *spi, struct spi_config *spi_cfg,
                   uint16_t *data) {
  struct spi_buf bufs = {.buf = data, .len = 2};
  struct spi_buf_set rx = {.buffers = &bufs};

  rx.count = 1;

  return spi_read(spi, spi_cfg, &rx);
}

int spi_slave_write(const struct device *spi, struct spi_config *spi_cfg,
                    uint16_t *data) {
  struct spi_buf bufs = {.buf = data, .len = 2};
  struct spi_buf_set tx = {.buffers = &bufs};

  tx.count = 1;

  return spi_write(spi, spi_cfg, &tx);
}

void main() {
  // Data to be exchanged
  uint16_t tx_data = 4;
  // uint16_t rx_data = 0;

  // Initialize SPI bus number 3
  const struct device *spi = device_get_binding("SPI_1");

  // SPI COnfiguration
  struct spi_config spi_cfg {
    .frequency = 3000000, .operation = SPI_WORD_SET(8) | SPI_OP_MODE_SLAVE
    // , .cs = &cs_ctrl
  };

  while (1) {
    // spi_slave_read(spi, &spi_cfg, &rx_data);
    spi_slave_write(spi, &spi_cfg, &tx_data);

    printk("Received:%d\n", (unsigned char)rx_data);
  }
}
```

## src/main_transceive.cpp
```c
#include <device.h>
#include <drivers/spi.h>

int spi_slave_read(const struct device *spi, struct spi_config *spi_cfg,
                   double *data) {
  struct spi_buf bufs = {.buf = data, .len = 2};
  struct spi_buf_set rx = {.buffers = &bufs};

  rx.count = 1;

  return spi_read(spi, spi_cfg, &rx);
}

int spi_slave_write(const struct device *spi, struct spi_config *spi_cfg,
                    double *data) {
  struct spi_buf bufs = {.buf = data, .len = 4};
  struct spi_buf_set tx = {.buffers = &bufs};

  tx.count = 1;

  return spi_write(spi, spi_cfg, &tx);
}

void main() {
  // Data to be exchanged
  double tx_data = 37773.6432;
  double rx_data = 8;

  // Initialize SPI bus number 3
  const struct device *spi = device_get_binding("SPI_1");

  // Chip select pin
  // const spi_cs_control cs_ctrl = {
  // 	.gpio_dev = device_get_binding("GPIOB"),
  // 	.delay = 0,
  // 	.gpio_pin = 6,
  // 	.gpio_dt_flags = GPIO_ACTIVE_LOW,
  // };

  // SPI COnfiguration
  struct spi_config spi_cfg {
    .frequency = 3600000U,
    .operation = SPI_WORD_SET(16) | SPI_TRANSFER_MSB | SPI_OP_MODE_MASTER
    // , .cs = &cs_ctrl
  };

  while (1) {
    spi_slave_read(spi, &spi_cfg, &rx_data);

    if (rx_data == 10) {
      spi_slave_write(spi, &spi_cfg, &tx_data);
    } else {
      spi_slave_write(spi, &spi_cfg, &tx_data);
    }
    printk("Received: %f -- %s\n", rx_data,
           (rx_data == 0x1234) ? "ok" : "wrong");
  }
}
```

## src/transceive_master.cpp
```c
#include <device.h>
#include <drivers/spi.h>
#include <stdio.h>

int spi_master_transceive(const struct device *spi, struct spi_config *spi_cfg,
                          uint16_t *tx_data, uint16_t *rx_data) {

  struct spi_buf tx_bufs = {.buf = tx_data, .len = 2};
  struct spi_buf_set tx = {.buffers = &tx_bufs};

  struct spi_buf rx_bufs = {.buf = rx_data, .len = 2};
  struct spi_buf_set rx = {.buffers = &rx_bufs};

  tx.count = 1;
  rx.count = 1;

  return spi_transceive(spi, spi_cfg, &tx, &rx);
}

void main() {
  // Data to be exchanged
  uint16_t tx_data = 6;
  uint16_t rx_data = 2;

  // Initialize SPI bus number 3
  const struct device *spi = device_get_binding("SPI_1");

  // Chip select pin
  // const spi_cs_control cs_ctrl = {
  // 	.gpio_dev = device_get_binding("GPIOB"),
  // 	.delay = 0,
  // 	.gpio_pin = 6,
  // 	.gpio_dt_flags = GPIO_ACTIVE_LOW,
  // };

  // SPI COnfiguration
  struct spi_config spi_cfg {
    .frequency = 3600000U,
    .operation = SPI_WORD_SET(16) | SPI_TRANSFER_MSB | SPI_OP_MODE_MASTER
    // , .cs = &cs_ctrl
  };

  while (1) {

    spi_master_transceive(spi, &spi_cfg, &tx_data, &rx_data);
    printf("Sent: %d\n", tx_data);
    printf("Received: %d\n\n", rx_data);
  }
}
```

## src/transceive_slave.cpp
```c
#include <device.h>
#include <drivers/spi.h>
#include <stdio.h>

int spi_master_transceive(const struct device *spi, struct spi_config *spi_cfg,
                          uint16_t *tx_data, uint16_t *rx_data) {

  struct spi_buf tx_bufs = {.buf = tx_data, .len = 2};
  struct spi_buf_set tx = {.buffers = &tx_bufs};

  struct spi_buf rx_bufs = {.buf = rx_data, .len = 2};
  struct spi_buf_set rx = {.buffers = &rx_bufs};

  tx.count = 1;
  rx.count = 1;

  return spi_transceive(spi, spi_cfg, &tx, &rx);
}

void main() {
  // Data to be exchanged
  uint16_t tx_data = 3;
  uint16_t rx_data = 5;

  // Initialize SPI bus number 3
  const struct device *spi = device_get_binding("SPI_1");

  // Chip select pin
  // const spi_cs_control cs_ctrl = {
  // 	.gpio_dev = device_get_binding("GPIOB"),
  // 	.delay = 0,
  // 	.gpio_pin = 6,
  // 	.gpio_dt_flags = GPIO_ACTIVE_LOW,
  // };

  // SPI COnfiguration
  struct spi_config spi_cfg {
    .frequency = 3600000U, .operation = SPI_WORD_SET(16) | SPI_OP_MODE_SLAVE
    // , .cs = &cs_ctrl
  };

  while (1) {

    spi_master_transceive(spi, &spi_cfg, &tx_data, &rx_data);
    printf("Sent: %d\n", tx_data);
    printf("Received: %d\n\n", rx_data);
  }
}
```
